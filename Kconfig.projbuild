## Kconfig.projbuild
```kconfig
menu "Thumb Config"

    config TC_PART_NAME
        string "Partition name"
        default "thumbcfg"
        help
            Set the partition name for data exchange. This partition must exist and must be in the same in partition table.

    config TC_MOUNT_PATH
        string "Config partition mount path"
        default "/etc"
        help
            Set the mount path.


endmenu
```
